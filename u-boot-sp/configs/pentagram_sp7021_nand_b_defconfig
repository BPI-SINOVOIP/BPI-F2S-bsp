## u-boot-sp/configs/pentagram_sp7021_nand_b_defconfig
```kconfig
CONFIG_ARM=y
CONFIG_ARCH_PENTAGRAM=y
CONFIG_TARGET_PENTAGRAM_B_BOOT=y
CONFIG_SYS_ENV_SP7021_EVB=y
CONFIG_DEFAULT_DEVICE_TREE="pentagram-common"
CONFIG_DEBUG_UART=y
CONFIG_BOOTDELAY=0
CONFIG_CMD_BOOTZ=y
CONFIG_CMD_MD5SUM=y
CONFIG_MD5SUM_VERIFY=y
CONFIG_CMD_MEMINFO=y
CONFIG_CMD_MMC=y
CONFIG_CMD_PART=y
CONFIG_CMD_USB=y
CONFIG_CMD_EXT2=y
CONFIG_CMD_FAT=y
CONFIG_CMD_MTDPARTS=y
CONFIG_EFI_PARTITION=y
CONFIG_OF_EMBED=y
CONFIG_DEVRES=y
CONFIG_DEBUG_DEVRES=y
CONFIG_MMC_SP_EMMC=y
CONFIG_MMC_SP_SD=y
CONFIG_DM_MMC=y
CONFIG_MTD=y
CONFIG_NAND=y
CONFIG_SP_SPINAND=y
CONFIG_ENV_IS_IN_NAND=y
CONFIG_DEBUG_UART_BASE=0x0
CONFIG_DEBUG_UART_CLOCK=90000
CONFIG_DEBUG_UART_SHIFT=2
CONFIG_SUNPLUS_SERIAL=y
CONFIG_USB=y
CONFIG_USB_STORAGE=y
CONFIG_REGEX=y
#
# Soc
#
CONFIG_OTP_SUNPLUS=y
#
# Pin controllers
#
CONFIG_PINCTRL=y
CONFIG_PINCTRL_FULL=y
CONFIG_PINCTRL_GENERIC=y
CONFIG_PINMUX=y
CONFIG_PINCTRL_SUNPLUS=y
#
# Net
#
CONFIG_DM_ETH=y
CONFIG_NETDEVICES=y
CONFIG_PHY_GIGE=y
CONFIG_SUNPLUS_L2SW=y
CONFIG_NET=y
CONFIG_LIB_RAND=y
CONFIG_NET_RANDOM_ETHADDR=y
#
# Network commands
#
CONFIG_CMD_NET=y
CONFIG_CMD_TFTPPUT=y
CONFIG_CMD_DHCP=y
CONFIG_CMD_UBI=y
CONFIG_CMD_UBIFS=y
CONFIG_CMD_PING=y
CONFIG_MTD_UBI=y
```

## u-boot-sp/configs/pentagram_zebu_defconfig
```kconfig
CONFIG_ARM=y
CONFIG_ARCH_PENTAGRAM=y
CONFIG_TARGET_PENTAGRAM_COMMON=y
CONFIG_SYS_ENV_ZEBU=y
CONFIG_DEFAULT_DEVICE_TREE="pentagram-common"
CONFIG_DEBUG_UART=y
CONFIG_BOOTDELAY=0
CONFIG_CMD_BOOTZ=y
CONFIG_CMD_MEMINFO=y
CONFIG_CMD_MMC=y
CONFIG_CMD_PART=y
# CONFIG_CMD_NET is not set
# CONFIG_CMD_NFS is not set
CONFIG_CMD_EXT2=y
CONFIG_CMD_FAT=y
CONFIG_EFI_PARTITION=y
CONFIG_OF_EMBED=y
CONFIG_DEVRES=y
CONFIG_DEBUG_DEVRES=y
CONFIG_DM_MMC=y
CONFIG_MMC_SP_EMMC=y
CONFIG_MMC_SP_SD=y
CONFIG_DEBUG_UART_BASE=0x0
CONFIG_DEBUG_UART_CLOCK=90000
CONFIG_DEBUG_UART_SHIFT=2
CONFIG_SUNPLUS_SERIAL=y
CONFIG_REGEX=y
CONFIG_USB=y
CONFIG_DM=y
CONFIG_CMD_USB=y
CONFIG_USB_EHCI_HCD=y
CONFIG_SPL_USB_HOST_SUPPORT=y
CONFIG_OTP_SUNPLUS=y
```

## u-boot-sp/configs/sp7021_demov2_defconfig
```kconfig
CONFIG_ARM=y
CONFIG_ARCH_PENTAGRAM=y
CONFIG_SYS_ENV_SP7021_EVB=y
CONFIG_SRCADDR_KERNEL=0x2222
CONFIG_SRCADDR_DTB=0x2022
CONFIG_SRCADDR_NONOS=0x1822
CONFIG_DEFAULT_DEVICE_TREE="sp7021-demov2"
CONFIG_DEBUG_UART=y
CONFIG_SD_BOOT=y
CONFIG_BOOTDELAY=0
CONFIG_CMD_BOOTZ=y
CONFIG_CMD_BOOTMENU=y
CONFIG_CMD_MD5SUM=y
CONFIG_MD5SUM_VERIFY=y
CONFIG_CMD_MEMINFO=y
CONFIG_CMD_GPT=y
CONFIG_CMD_GPT_RENAME=y
CONFIG_CMD_MMC=y
CONFIG_CMD_PART=y
CONFIG_CMD_USB=y
CONFIG_CMD_UUID=y
CONFIG_CMD_EXT2=y
CONFIG_CMD_FAT=y
CONFIG_CMD_EXT4=y
CONFIG_CMD_FS_GENERIC=y
CONFIG_CMD_PXE=y
CONFIG_OF_SEPARATE=y
CONFIG_ENV_IS_IN_MMC=y
CONFIG_DEVRES=y
CONFIG_DEBUG_DEVRES=y
CONFIG_DM_MMC=y
CONFIG_MMC_SP_EMMC=y
CONFIG_MMC_SP_7021_SD=y
CONFIG_DEBUG_UART_BASE=0x0
CONFIG_DEBUG_UART_CLOCK=90000
CONFIG_DEBUG_UART_SHIFT=2
CONFIG_SUNPLUS_SERIAL=y
CONFIG_REGEX=y
#
# Soc
#
CONFIG_OTP_SUNPLUS=y
#
# Pin controllers
#
CONFIG_PINCTRL=y
CONFIG_PINCTRL_FULL=y
CONFIG_PINCTRL_GENERIC=y
CONFIG_PINMUX=y
CONFIG_PINCTRL_SUNPLUS=y
#
# Net
#
CONFIG_DM_ETH=y
CONFIG_NETDEVICES=y
CONFIG_PHY_GIGE=y
CONFIG_SUNPLUS_L2SW=y
CONFIG_NET=y
CONFIG_LIB_RAND=y
CONFIG_NET_RANDOM_ETHADDR=y
#
# Network commands
#
CONFIG_CMD_NET=y
CONFIG_CMD_TFTPPUT=y
CONFIG_CMD_DHCP=y
CONFIG_CMD_PING=y
#
# Display
#
CONFIG_VIDEO_SP7021=y
CONFIG_DM_VIDEO_SP7021_LOGO=n
#
# Keyboard
#
CONFIG_DM_KEYBOARD=y
CONFIG_USB_KEYBOARD=y
#
# USB
#
CONFIG_USB=y
CONFIG_USB_OHCI_HCD=y
CONFIG_USB_STORAGE=y
```

## u-boot-sp/drivers/pinctrl/sunplus/Kconfig
```kconfig
config PINCTRL_SUNPLUS
	depends on DM && (ARCH_PENTAGRAM && !TARGET_PENTAGRAM_I143_C)
	default y
	bool "Sunplus SP7021 pin control driver"
	help
	   Support pin multiplexing and pin configuration control on
	   Sunplus's SP7021 SoC.

config PINCTRL_SUNPLUS_I143
	depends on DM && (TARGET_PENTAGRAM_I143_P || TARGET_PENTAGRAM_I143_C)
	default y
	bool "Sunplus I143 pin control driver"
	help
	   Support pin configuration control on Sunplus's i143 SoC.
```

## u-boot-sp/drivers/soc/sunplus/Kconfig
```kconfig
config OTP_SUNPLUS
	bool "Enable OTP driver support for Sunplus SoC"
	help
	  This OTP driver supports Sunplus SP7021 and I143 SoC.
	  Say Y if you want to enable OTP function.
```

## u-boot-sp/drivers/video/sunplus/Kconfig
```kconfig
#
# Sunplus Video configuration
#

source "drivers/video/sunplus/sp7021/disp/Kconfig"
#source "drivers/video/sunplus/sp7021/mipi/Kconfig"
source "drivers/video/sunplus/i143/disp/Kconfig"
source "drivers/video/sunplus/i143/mipi/Kconfig"
```

## u-boot-sp/drivers/video/sunplus/i143/disp/Kconfig
```kconfig
# SPDX-License-Identifier: GPL-2.0+
#
# Copyright (C) 2020 Sunplus - All Rights Reserved
#
# Authors: Hammer Hsieh <hammer.hsieh@sunplus.com>
#

menuconfig VIDEO_I143
	bool "Enable I143 video support"
	select DM_VIDEO
	select DM_GPIO
	# default y
	help
	  I143 supports HDMI video output options.
	  This option enables these supports which can be used on
	  HDMI display connected.

config VIDEO_I143_MAX_XRES
	int "Maximum horizontal resolution (for memory allocation purposes)"
	depends on VIDEO_I143
	default 720
	help
	  The maximum horizontal resolution to support for the framebuffer.
	  This configuration is used for reserving/allocating memory for the
	  framebuffer during device-model binding/probing.

config VIDEO_I143_MAX_YRES
	int "Maximum vertical resolution (for memory allocation purposes)"
	depends on VIDEO_I143
	default 480
	help
	  The maximum vertical resolution to support for the framebuffer.
	  This configuration is used for reserving/allocating memory for the
	  framebuffer during device-model binding/probing.

config VIDEO_I143_MAX_BPP
	int "Maximum bits per pixel (for memory allocation purposes)"
	depends on VIDEO_I143
	default 8
	help
	  The maximum bits per pixel to support for the framebuffer.
	  This configuration is used for reserving/allocating memory for the
	  framebuffer during device-model binding/probing.

config VIDEO_I143_ROTATE
	int "Console Text Rotate Angle Setting"
	depends on VIDEO_I143
	default 0
	help
	  Rotate angle 0: 0 degree / 1: 90 degree / 2: 180 degree / 3: 270 degree.

config BMP_8BPP_UPDATE_CMAP
	bool "Enable I143 Update Palette for 8BPP"
	depends on DM_VIDEO && VIDEO_I143
	default y
	help
		Allow 8BPP format update palette.

config DM_VIDEO_I143_LOGO
	bool "Enable I143 video LOGO support"
	depends on DM_VIDEO && VIDEO_I143
	default y
	help
		Logo display support

config DM_VIDEO_I143_LOGO_ALIGN
	bool "Align I143 video LOGO to center"
	depends on DM_VIDEO && VIDEO_I143
	default n
	help
		Logo display support , align to center

config VIDEO_BMP_LOGO_MANUAL
	bool "LOGO display by manual"
	depends on DM_VIDEO && VIDEO_I143
	default n
	help
		Logo display by manual
```

## u-boot-sp/drivers/video/sunplus/i143/mipi/Kconfig
```kconfig
# SPDX-License-Identifier: GPL-2.0+
#
# Copyright (C) 2020 Sunplus - All Rights Reserved
#
# Authors: Cc Ho <cc.ho@sunplus.com>
#

config MIPI_VALID_SUNPLUS_I143
	bool "Enable Sunplus I143 MIPI Validation"
	depends on TARGET_PENTAGRAM_I143_P || TARGET_PENTAGRAM_I143_C
	default n
	help
	  Enable Sunplus Video-In uboot command to validate Sunplus I143 MIPI CSI
	  functions.
```

## u-boot-sp/drivers/video/sunplus/sp7021/disp/Kconfig
```kconfig
# SPDX-License-Identifier: GPL-2.0+
#
# Copyright (C) 2020 Sunplus - All Rights Reserved
#
# Authors: Hammer Hsieh <hammer.hsieh@sunplus.com>
#

menuconfig VIDEO_SP7021
	bool "Enable SP7021 video support"
	depends on DM_VIDEO
	# default y
	help
	  SP7021 supports many video output options including RGB and
	  HDMI. This option enables these supports which can be used on
	  devices which have RGB TFT or HDMI display connected.

config EN_SP7021_TTL
	bool "Enable SP7021 TTL out"
	depends on DM_VIDEO && VIDEO_SP7021
	default n
	help
		Enable TTL output , HDMITX will be turn off.

config VIDEO_SP7021_MAX_XRES
	int "Maximum horizontal resolution (for memory allocation purposes)"
	depends on VIDEO_SP7021
	default 720
	help
	  The maximum horizontal resolution to support for the framebuffer.
	  This configuration is used for reserving/allocating memory for the
	  framebuffer during device-model binding/probing.

config VIDEO_SP7021_MAX_YRES
	int "Maximum vertical resolution (for memory allocation purposes)"
	depends on VIDEO_SP7021
	default 480
	help
	  The maximum vertical resolution to support for the framebuffer.
	  This configuration is used for reserving/allocating memory for the
	  framebuffer during device-model binding/probing.

config VIDEO_SP7021_MAX_BPP
	int "Maximum bits per pixel (for memory allocation purposes)"
	depends on VIDEO_SP7021
	default 8
	help
	  The maximum bits per pixel to support for the framebuffer.
	  This configuration is used for reserving/allocating memory for the
	  framebuffer during device-model binding/probing.

config VIDEO_SP7021_ROTATE
	int "Console Text Rotate Angle Setting"
	depends on VIDEO_SP7021
	default 0
	help
	  Rotate angle 0: 0 degree / 1: 90 degree / 2: 180 degree / 3: 270 degree.

config BMP_8BPP_UPDATE_CMAP
	bool "Enable SP7021 Update Palette for 8BPP"
	depends on DM_VIDEO && VIDEO_SP7021
	default y
	help
		Allow 8BPP format update palette.

config DM_VIDEO_SP7021_LOGO
	bool "Enable SP7021 video LOGO support"
	depends on DM_VIDEO && VIDEO_SP7021
	default y
	help
		Logo display support

config DM_VIDEO_SP7021_LOGO_ALIGN
	bool "Align SP7021 video LOGO to center"
	depends on DM_VIDEO && VIDEO_SP7021
	default n
	help
		Logo display support , align to center

config VIDEO_BMP_LOGO_MANUAL
	bool "LOGO display by manual"
	depends on DM_VIDEO && VIDEO_SP7021
	default n
	help
		Logo display by manual
```
