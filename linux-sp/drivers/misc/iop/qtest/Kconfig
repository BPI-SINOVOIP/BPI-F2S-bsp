## linux-sp/drivers/misc/iop/qtest/Kconfig
```kconfig
#
# IOP subsystem configuration
#

menu "Q TEST CBDMA"

config SUNPLUS_QTEST_CBDMA
	tristate "QTEST CBDMA"
	default n
	help
		QTEST CBDMA

endmenu
```

## linux-sp/drivers/mtd/nand/Kconfig
```kconfig
menuconfig MTD_NAND_CORE
	tristate "SPI-NAND device support"
	depends on MTD
	help
	  This enables support for accessing all type of NAND flash
	  devices. For further information see
	  <http://www.linux-mtd.infradead.org/doc/nand.html>.

if MTD_NAND_CORE

source "drivers/mtd/nand/onenand/Kconfig"

source "drivers/mtd/nand/raw/Kconfig"

source "drivers/mtd/nand/spi/Kconfig"

endif # MTD_NAND_CORE
```

## linux-sp/drivers/net/ethernet/sp/Kconfig
```kconfig
#
# Sunplus Ethernet device configuration
#

config NET_VENDOR_SUNPLUS
	tristate "Sunplus Ethernet devices"
	depends on ETHERNET
	select PHYLIB
	select PINCTRL_SPPCTL
	select SUNPLUS_SP7021_RESET
	select NVMEM_SUNPLUS_OCOTP
	---help---
	  If you have a Sunplus network (Ethernet) device belonging to this class,
	  say Y.

	  Note that the answer to this question doesn't directly affect
	  the kernel: saying N will just cause the configurator to skip all
	  the questions about Sunplus device. If you say Y, you will be asked
	  for your specific device in the following questions.

config DYNAMIC_MODE_SWITCHING_BY_SYSFS
	bool "Support Dynamic Mode-switching by sysfs"
	depends on NET_VENDOR_SUNPLUS
	default y
	---help---
	  Supports dynamic mode-switching by sysfs.
```

## linux-sp/drivers/net/ethernet/sunplus/Kconfig
```kconfig
#
# Sunplus Ethernet device configuration
#

config NET_VENDOR_SUNPLUS
	tristate "Sunplus Ethernet devices"
	depends on ETHERNET && SOC_SP7021
	select PHYLIB
	select PINCTRL_SPPCTL
	select COMMON_CLK_SP7021
	select RESET_SUNPLUS
	select NVMEM_SUNPLUS_OCOTP
	---help---
	  If you have a Sunplus network (Ethernet) device belonging to this class,
	  say Y.

	  Note that the answer to this question doesn't directly affect
	  the kernel: saying N will just cause the configurator to skip all
	  the questions about Sunplus device. If you say Y, you will be asked
	  for your specific device in the following questions.

config NET_VENDOR_SUNPLUS_GL2SW
	tristate "Sunplus Giga Ethernet devices"
	depends on ETHERNET && SOC_I143
	select PHYLIB
	select PINCTRL_SPPCTL_I143
	select COMMON_CLK_SP_I143
	select RESET_SUNPLUS
	select NVMEM_SUNPLUS_OCOTP
	---help---
	  If you have a network (Ethernet) device belonging to this class, say Y.

	  Note that the answer to this question doesn't directly affect
	  the kernel: saying N will just cause the configurator to skip all
	  the questions about Sunplus device. If you say Y, you will be asked
	  for your specific device in the following questions.

config DYNAMIC_MODE_SWITCHING_BY_SYSFS
	bool "Support Dynamic Mode-switching by sysfs"
	depends on NET_VENDOR_SUNPLUS || NET_VENDOR_SUNPLUS_GL2SW
	default y
	---help---
	  This mode supports dynamic mode-switching by sysfs:
```

## linux-sp/drivers/pinctrl/sppctl/Kconfig
```kconfig
config PINCTRL_SPPCTL
	bool "SunPlus SP7021 pinmux and gpio driver"
	depends on ARCH_PENTAGRAM
	select PINMUX
	select GENERIC_PINCTRL_GROUPS
	select CONFIG_GENERIC_PINMUX_FUNCTIONS
	select PINCONF
	select GENERIC_PINCONF
	select OF_GPIO
	select GPIOLIB
	select GPIO_SYSFS
	select GENERIC_IRQ_CHIP
	select GPIOLIB_IRQCHIP
	help
	    Say Y here to support SunPlus SP7021 pinmux controller.
	    GPIO is provided by the same driver.

config PINCTRL_SPPCTL_DEBUG
	bool "SunPlus SP7021 mux specific debug"
	depends on ARCH_PENTAGRAM && DEBUG_PINCTRL
	help
	    Say Y if you need to debug SP7021 mux driver in-depth.
```

## linux-sp/drivers/pinctrl/sunplus/Kconfig
```kconfig
config PINCTRL_SPPCTL
	bool "Sunplus SP7021 pinmux and gpio driver"
	depends on SOC_SP7021
	select PINMUX
	select GENERIC_PINCTRL_GROUPS
	select CONFIG_GENERIC_PINMUX_FUNCTIONS
	select PINCONF
	select GENERIC_PINCONF
	select OF_GPIO
	select GPIOLIB
	select GPIO_SYSFS
	select GENERIC_IRQ_CHIP
	select GPIOLIB_IRQCHIP
	help
	    Say Y here to support Sunplus SP7021 pinmux controller.
	    GPIO is provided by the same driver.

config PINCTRL_SPPCTL_I143
	bool "Sunplus I143 pinmux and gpio driver"
	depends on SOC_I143
	select PINMUX
	select GENERIC_PINCTRL_GROUPS
	select CONFIG_GENERIC_PINMUX_FUNCTIONS
	select PINCONF
	select GENERIC_PINCONF
	select OF_GPIO
	select GPIOLIB
	select GPIO_SYSFS
	select GENERIC_IRQ_CHIP
	select GPIOLIB_IRQCHIP
	help
	    Say Y here to support Sunplus I143 pinmux controller.
	    GPIO is provided by the same driver.

config PINCTRL_SPPCTL_DEBUG
	bool "Sunplus pinmux specific debug"
	depends on (SOC_SP7021 || SOC_I143) && DEBUG_PINCTRL
	help
	    Say Y if you need to debug Sunplus pinmux driver in-depth.
```

## linux-sp/drivers/pwm/pwm_sp7021/Kconfig
```kconfig
config PWM_SP7021
	tristate "SP7021 PWM support"
	depends on ARCH_PENTAGRAM
	help
	  Generic PWM framework driver for SP7021.

	  To compile this driver as a module, choose M here: the module
	  will be called pwm_sp7021.
```

## linux-sp/drivers/soc/axi_monitor/Kconfig
```kconfig
#
# AXI Monitor subsystem configuration
#

menu "AXI Monitor"

config SUNPLUS_AXI_MONITOR
	tristate "AXI Monitor support"
	default y
	help
		Breakpoint analysis of BackBone-Dram problem.
#source "drivers/soc/iop/qtest/Kconfig"
endmenu
```

## linux-sp/drivers/soc/sunplus/Kconfig
```kconfig
#
# AXI Monitor subsystem configuration
#

menu "Sunplus AXI Monitor"

config SUNPLUS_AXI_MONITOR
	tristate "Sunplus AXI monitor support"
	default n
	help
	  Sunplus breakpoint analysis of backbone-dram problem.
#source "drivers/soc/iop/qtest/Kconfig"
endmenu
```

## linux-sp/drivers/usb/gadget/udc/sunplus/i143/Kconfig
```kconfig
config USB_GADGET_I143
 	tristate "Sunplus I143 Gemini USB Device Controller"
 	depends on SOC_I143
 	select USB_GADGET_DUALSPEED
 	help
	   This option selects the USB device controller for Sunplus I143.
```

## linux-sp/drivers/usb/gadget/udc/sunplus/sp7021/Kconfig
```kconfig
config USB_GADGET_SP7021
 	tristate "Sunplus SP7021 Gemini USB Device Controller"
 	depends on SOC_SP7021
 	select USB_GADGET_DUALSPEED
 	default y
 	help
	   This option selects the USB device controller for Sunplus SP7021.
```

## linux-sp/drivers/video/fbdev/fb_sp7021/Kconfig
```kconfig
config FB_SP7021
	tristate "SP7021 Graphics Backend framebuffer support"
	depends on FB && ARCH_PENTAGRAM && VIDEO_SP_DISP
	help
	  This is the frame buffer device driver for the SP7021 Graphics
	  hardware.

config FB_SP7021_DEBUG
	bool "External Debug support"
	depends on FB_SP7021
	help
	  Say Y here, if you want to have debug support.
```

## linux-sp/drivers/video/fbdev/sunplus/fb_i143/Kconfig
```kconfig
config FB_I143
	tristate "I143 Graphics Backend framebuffer support"
	depends on FB && SOC_I143 && VIDEO_I143_DISP
	default y
	select FB_CFB_FILLRECT
	select FB_CFB_COPYAREA
	select FB_CFB_IMAGEBLIT
	help
	  This is the frame buffer device driver for the I143 Graphics
	  hardware.

config FB_I143_DEBUG
	bool "External Debug support"
	depends on FB_I143
	help
	  Say Y here, if you want to have debug support.
```

## linux-sp/drivers/video/fbdev/sunplus/fb_sp7021/Kconfig
```kconfig
config FB_SP7021
	tristate "SP7021 Graphics Backend framebuffer support"
	depends on FB && SOC_SP7021 && VIDEO_SP7021_DISP
	default y
	select FB_CFB_FILLRECT
	select FB_CFB_COPYAREA
	select FB_CFB_IMAGEBLIT
	help
	  This is the frame buffer device driver for the SP7021 Graphics
	  hardware.

config FB_SP7021_DEBUG
	bool "External Debug support"
	depends on FB_SP7021
	help
	  Say Y here, if you want to have debug support.
```

## linux-sp/sound/soc/sunplus/Kconfig
```kconfig
menuconfig SND_SOC_SUNPLUS
	tristate "ASoC support for Sunplus"
	#depends on ARCH_SUNPLUS
	select SND_SOC_SPDIF
	default y
	help
	  Say Y or M if you want to add support for codecs attached to
	  the Sunplus SoCs' Audio interfaces. You will also need to
	  select the audio interfaces to support below.

config SND_SOC_AUD628
	tristate "support Q628 codec"
	depends on SND_SOC_SUNPLUS
	default y
```

## u-boot-sp/arch/arm/mach-pentagram/Kconfig
```kconfig
if ARCH_PENTAGRAM

choice
	prompt "Board select"

config TARGET_PENTAGRAM_COMMON
	bool "pentagram common board"
	select CPU_V7A
    #select CPU_V7_HAS_NONSEC
    #select CPU_V7_HAS_VIRT
	select SYS_THUMB_BUILD

config TARGET_PENTAGRAM_B_BOOT
	bool "pentagram common board (B boot)"
	select CPU_ARM926EJS

config TARGET_PENTAGRAM_I143_C
	bool "pentagram common board (I143 C-chip)"
	select CPU_V7A
	select SYS_THUMB_BUILD
endchoice

choice
	prompt "BPI Board select"

config BOARD_BPI_F2S
        bool "bananapi f2s board"

config BOARD_BPI_F2P
        bool "bananapi f2p board"
endchoice

config BPI_BOARD
        string
        default "bpi-f2s" if BOARD_BPI_F2S
        default "bpi-f2p" if BOARD_BPI_F2P
        default ""
        help
          This option contains information about bpi board name.

choice
	prompt "Verification Environment"

config SYS_ENV_ZEBU
	bool "zebu environment"

config SYS_ENV_8388
	bool "8388 environment"

config SYS_ENV_SP7021_EVB
	bool "sp7021 EVB"

endchoice

config SYS_ZMEM_SKIP_RELOC
	bool "zmem skip reloc"
	default y
	depends on SYS_ENV_ZEBU && !SD_BOOT && !NAND_BOOT

config SP_ZMEM_RELOC_ADDR
	hex "zmem reloc address"
	default 0x1F00000
	depends on SYS_ZMEM_SKIP_RELOC
	help
	  Fixed reloc address of u-boot on zmem environemnt.
	  This address is chosen by zmem firmware so follow
	  the zmem layout to assign this value. Zmem will
	  put the image with header on this address so the
	  first word of this address will be first 4 bytes
	  of header not the ENTRY() of text code.

config SP_TIMER
	bool "Sunplus timer"
	default y
	help
	  Support Sunplus STC timer

source "board/sunplus/pentagram_board/Kconfig"

endif
```

## u-boot-sp/board/sunplus/i143/Kconfig
```kconfig
if TARGET_PENTAGRAM_I143_P

config SYS_BOARD
	default "i143"

config SYS_VENDOR
	default "sunplus"
	
config SYS_CPU
	default "generic"
	
config SYS_CONFIG_NAME
	default "pentagram_common_i143_p"
	
config SYS_TEXT_BASE
	default 0xA1000000 

config SP_UTIL_MON
	bool "enable Sunplus mon util"
	default y
	help
	  Enable Sunplys mon util
	  It is useful to read/write Sunplus register
	  group.
	  
config BOARD_SPECIFIC_OPTIONS # dummy
	def_bool y
	select GENERIC_RISCV
	imply CMD_DHCP
	imply CMD_EXT2
	imply CMD_EXT4
	imply CMD_FAT
	imply CMD_FS_GENERIC
	imply CMD_NET
	imply CMD_PING
	imply CLK_SIFIVE
	imply CLK_SIFIVE_FU540_PRCI
	imply DOS_PARTITION
	imply EFI_PARTITION
	imply IP_DYN
	imply ISO_PARTITION
	imply MACB
	imply MII
	imply NET_RANDOM_ETHADDR
	imply PHY_LIB
	imply PHY_MSCC
	imply SIFIVE_SERIAL

endif
```

## u-boot-sp/board/sunplus/pentagram_board/Kconfig
```kconfig
if TARGET_PENTAGRAM_COMMON || TARGET_PENTAGRAM_B_BOOT

config SYS_CONFIG_NAME
	default "pentagram_common"
	select CMD_TPS_UPD

config SYS_SOC
	default "pentagram"

config SYS_BOARD
	default "pentagram_board"

config SYS_VENDOR
	default "sunplus"

config SYS_TEXT_BASE
	default 0x200040

config SYS_USE_QKBOOT_HEADER
	bool "use Sunpls quick boot header"
	default n
	help
	  Enable Sunplus quick boot header
	  Sunplus quick boot header is the same
	  as mkimage header. It also has 64 bytes
	  size with the same fields. We only change
	  crc and type in generic mkimage header.
	  It can speed up boot time. If enabled, we
	  replace mkimage header of kernel image and
	  also add sunplus-mkimage header on dtb image.

config SRCADDR_KERNEL
	hex "Linux kernel source address"
	default 0x0 if SD_BOOT
	default 0x0 if NAND_BOOT
	default 0x98600000
	help
	  Linux kernel source address
	  Linux kernel image is stored in this
	  address. This address can be nand/emmc
	  address.

config SRCADDR_DTB
	hex "DTB source address"
	default 0x0 if SD_BOOT
	default 0x0 if NAND_BOOT
	default 0x98020000
	help
	  DTB(device tree blob) source address
	  DTB image is stored in this address.
	  This address can be nand/emmc address.

config HUSH_PARSER
	default y

config SP_UTIL_MON
	bool "enable Sunplus mon util"
	default y
	help
	  Enable Sunplys mon util
	  It is useful to read/write Sunplus register
	  group.

config SP_JTAG
	bool "enable JTAG"
	default y
	help
	  Setup JTAG setting
	  For CA7, setup SWD config and pinmux.
	  For arm926, setup JTAG config and pinmux.
	  Notice that it is necessary to pull IV_MX[6]
	  for releasing reset pin. IV_MX[6] may be tied
	  on PCB board.

config CMD_TPS_MD
	bool "MD button check shell api"
	default n

config CMD_TPS_UPD
	bool "Tibbo update command"
	default y

config TPS_UPD_MMC
	bool "tps_upd src - mmc"
	default y if DM_MMC

config TPS_UPD_NAND
	bool "tps_upd src/dst - nand"
	default y if NAND

config TPS_UPD_TFTP
	bool "tps_upd src - tftp"
	default y if NET

config TPS_UPD_USB
	bool "tps_upd src - usb"
	default y if USB

endif
```

## u-boot-sp/configs/i143_emmc_p_defconfig
```kconfig
CONFIG_RISCV=y
CONFIG_SYS_TEXT_BASE=0xA0100040
CONFIG_SRCADDR_KERNEL=0x2222
CONFIG_SMP=y
CONFIG_TARGET_PENTAGRAM_I143_P=y
CONFIG_ARCH_RV64I=y
CONFIG_CMODEL_MEDANY=y
CONFIG_RISCV_SMODE=y
CONFIG_SRCADDR_FREERTOS=0x1822
CONFIG_SRCADDR_DTB=0x2022
CONFIG_DISTRO_DEFAULTS=y
CONFIG_NR_DRAM_BANKS=1
CONFIG_FIT=y
CONFIG_BOOTDELAY=0
# CONFIG_USE_BOOTCOMMAND is not set
CONFIG_BOARD_LATE_INIT=y
CONFIG_MISC_INIT_R=y
CONFIG_DISPLAY_CPUINFO=y
CONFIG_DISPLAY_BOARDINFO=y
CONFIG_CMD_BOOTZ=y
CONFIG_CMD_MD5SUM=y
CONFIG_MD5SUM_VERIFY=y
CONFIG_CMD_MEMINFO=y
CONFIG_CMD_GPT=y
CONFIG_CMD_GPT_RENAME=y
CONFIG_CMD_MMC=y
CONFIG_CMD_PART=y
CONFIG_CMD_USB=y
CONFIG_CMD_UUID=y
CONFIG_CMD_EXT2=y
CONFIG_CMD_FAT=y
CONFIG_CMD_EXT4=y
CONFIG_CMD_FS_GENERIC=y
CONFIG_CMD_PXE=y
CONFIG_DEFAULT_DEVICE_TREE="i143-ev"
# CONFIG_NET is not set
CONFIG_ENV_IS_IN_MMC=y
CONFIG_DEVRES=y
CONFIG_DEBUG_DEVRES=y
# CONFIG_CLK is not set
# CONFIG_DM_GPIO is not set
CONFIG_DM_MMC=y
CONFIG_MMC=y
CONFIG_MMC_SP_EMMC=y
CONFIG_MMC_SP_SD=y
CONFIG_PINCTRL=y
CONFIG_PINCTRL_FULL=y
CONFIG_PINCTRL_GENERIC=y
CONFIG_PINMUX=y
CONFIG_PINCTRL_SUNPLUS_I143=y
# CONFIG_SIFIVE_SERIAL is not set
CONFIG_SP_TIMER=y
CONFIG_SUNPLUS_SERIAL=y
CONFIG_OTP_SUNPLUS=y
# CONFIG_TIMER is not set
CONFIG_USB=y
CONFIG_USB_STORAGE=y
CONFIG_REGEX=y
CONFIG_OF_SEPARATE=y
CONFIG_CMD_UNZIP=y
CONFIG_USB_XHCI_HCD=y
CONFIG_USB_XHCI_SPDWC3=y
# CONFIG_DM_VIDEO is not set
```

## u-boot-sp/configs/i143_romter_c_defconfig
```kconfig
CONFIG_ARM=y
CONFIG_ARCH_PENTAGRAM=y
CONFIG_TARGET_PENTAGRAM_I143_C=y
CONFIG_SYS_ENV_SP7021_EVB=y
CONFIG_SRCADDR_KERNEL=0x78600000
CONFIG_SRCADDR_DTB=0x78020000
CONFIG_SYS_TEXT_BASE=0x20100000
CONFIG_DEFAULT_DEVICE_TREE="i143-ev"
CONFIG_DEBUG_UART=y
CONFIG_BOOTDELAY=0
CONFIG_CMD_BOOTZ=y
CONFIG_CMD_MD5SUM=y
CONFIG_MD5SUM_VERIFY=y
CONFIG_CMD_MEMINFO=y
CONFIG_CMD_PART=y
CONFIG_CMD_USB=n
CONFIG_CMD_EXT2=y
CONFIG_CMD_FAT=y
CONFIG_OF_SEPARATE=y
CONFIG_DEVRES=y
CONFIG_DEBUG_DEVRES=y
# CONFIG_MMC is not set
CONFIG_DM_MMC=n
CONFIG_DEBUG_UART_BASE=0x0
CONFIG_DEBUG_UART_CLOCK=90000
CONFIG_DEBUG_UART_SHIFT=2
CONFIG_SUNPLUS_SERIAL=y
CONFIG_USB=n
CONFIG_REGEX=y
CONFIG_USB_STORAGE=y
CONFIG_OTP_SUNPLUS=y
CONFIG_PINCTRL=y
CONFIG_PINCTRL_FULL=y
CONFIG_PINCTRL_GENERIC=y
CONFIG_PINMUX=y
CONFIG_PINCTRL_SUNPLUS_I143=y
CONFIG_DM_ETH=n
CONFIG_NETDEVICES=y
CONFIG_PHY_GIGE=y
CONFIG_SUNPLUS_L2SW=y
CONFIG_NET=n
CONFIG_LIB_RAND=y
CONFIG_NET_RANDOM_ETHADDR=y
CONFIG_CMD_NET=y
CONFIG_CMD_TFTPPUT=y
CONFIG_CMD_DHCP=y
CONFIG_CMD_PING=y
CONFIG_CMD_UNZIP=y
# CONFIG_CMD_TPS_MD is not set
# CONFIG_CMD_TPS_UPD is not set
# CONFIG_TPS_UPD_MMC is not set
# CONFIG_TPS_UPD_NAND is not set
# CONFIG_TPS_UPD_TFTP is not set
# CONFIG_TPS_UPD_USB is not set
# CONFIG_TFABOOT is not set
# CONFIG_DM_VIDEO is not set
```
