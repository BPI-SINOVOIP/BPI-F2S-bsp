## u-boot-sp/configs/i143_romter_p_defconfig
```kconfig
CONFIG_RISCV=y
CONFIG_SYS_TEXT_BASE=0xA0100040
CONFIG_SMP=y
CONFIG_TARGET_PENTAGRAM_I143_P=y
CONFIG_ARCH_RV64I=y
CONFIG_CMODEL_MEDANY=y
CONFIG_RISCV_SMODE=y
CONFIG_DISTRO_DEFAULTS=y
CONFIG_NR_DRAM_BANKS=1
CONFIG_FIT=y
CONFIG_BOOTDELAY=0
# CONFIG_USE_BOOTCOMMAND is not set
CONFIG_BOARD_LATE_INIT=y
CONFIG_MISC_INIT_R=y
CONFIG_DISPLAY_CPUINFO=y
CONFIG_DISPLAY_BOARDINFO=y
CONFIG_CMD_MD5SUM=y
CONFIG_MD5SUM_VERIFY=y
CONFIG_CMD_MEMINFO=y
CONFIG_CMD_USB=y
CONFIG_CMD_UUID=y
# CONFIG_ISO_PARTITION is not set
CONFIG_DEFAULT_DEVICE_TREE="i143-ev"
CONFIG_NET=y
# CONFIG_PHY_MSCC is not set
CONFIG_SUNPLUS_GL2SW=y
CONFIG_RGMII=y
# CONFIG_CLK is not set
# CONFIG_DM_GPIO is not set
# CONFIG_MACB is not set
CONFIG_PINCTRL=y
CONFIG_PINCTRL_FULL=y
CONFIG_PINCTRL_GENERIC=y
CONFIG_PINMUX=y
CONFIG_PINCTRL_SUNPLUS_I143=y
# CONFIG_SIFIVE_SERIAL is not set
CONFIG_SUNPLUS_SERIAL=y
CONFIG_OTP_SUNPLUS=y
# CONFIG_TIMER is not set
CONFIG_USB=y
CONFIG_SP_TIMER=y
CONFIG_OF_SEPARATE=y
CONFIG_CMD_UNZIP=y
CONFIG_USB_XHCI_HCD=y
CONFIG_USB_XHCI_SPDWC3=y
# CONFIG_DM_VIDEO is not set
```

## u-boot-sp/configs/i143_romter_p_zebu_defconfig
```kconfig
CONFIG_RISCV=y
CONFIG_TARGET_PENTAGRAM_I143_P=y
CONFIG_RISCV_SMODE=y
CONFIG_ARCH_RV64I=y
CONFIG_DISTRO_DEFAULTS=y
CONFIG_NR_DRAM_BANKS=1
CONFIG_FIT=y
CONFIG_CMODEL_MEDANY=y
# CONFIG_USE_BOOTARGS is not set
# CONFIG_USE_BOOTCOMMAND is not set
# CONFIG_USE_PREBOOT is not set
# CONFIG_BOARD_LATE_INIT is not set
CONFIG_DISPLAY_CPUINFO=y
CONFIG_DISPLAY_BOARDINFO=y
#CONFIG_USE_BOOTCOMMAND is not set
# CONFIG_MACB is not set
# CONFIG_CLK is not set
# CONFIG_SIFIVE_SERIAL is not set
# CONFIG_BITBANGMII is not set
# CONFIG_TIMER is not set
CONFIG_SUNPLUS_SERIAL=y
CONFIG_DEFAULT_DEVICE_TREE="sunplus_i143"
CONFIG_SYS_TEXT_BASE=0xA0100000
CONFIG_OTP_SUNPLUS=y
CONFIG_SP_TIMER=y
CONFIG_SMP=y
CONFIG_OF_SEPARATE=y
CONFIG_SYS_ZEBU_ENV=y
CONFIG_BOOTDELAY=0
CONFIG_CMD_UNZIP=y
# CONFIG_DM_GPIO is not set
# CONFIG_DM_VIDEO is not set
```

## u-boot-sp/configs/pentagram_8388_defconfig
```kconfig
CONFIG_ARM=y
CONFIG_ARCH_PENTAGRAM=y
CONFIG_TARGET_PENTAGRAM_COMMON=y
CONFIG_SYS_ENV_8388=y
CONFIG_DEFAULT_DEVICE_TREE="pentagram-common"
CONFIG_DEBUG_UART=y
CONFIG_BOOTDELAY=0
CONFIG_CMD_BOOTZ=y
CONFIG_CMD_MEMINFO=y
CONFIG_CMD_MMC=y
CONFIG_CMD_PART=y
# CONFIG_CMD_NET is not set
# CONFIG_CMD_NFS is not set
CONFIG_CMD_EXT2=y
CONFIG_CMD_FAT=y
CONFIG_EFI_PARTITION=y
CONFIG_OF_EMBED=y
CONFIG_DEVRES=y
CONFIG_DEBUG_DEVRES=y
CONFIG_DM_MMC=y
CONFIG_MMC_SP_8388=y
CONFIG_DEBUG_UART_BASE=0x0
CONFIG_DEBUG_UART_CLOCK=90000
CONFIG_DEBUG_UART_SHIFT=2
CONFIG_SUNPLUS_SERIAL=y
CONFIG_REGEX=y
CONFIG_USB=y
CONFIG_CMD_USB=y
CONFIG_USB_STORAGE=y
```

## u-boot-sp/configs/pentagram_8388_emmc_defconfig
```kconfig
CONFIG_ARM=y
CONFIG_ARCH_PENTAGRAM=y
CONFIG_SYS_ENV_8388=y
CONFIG_SRCADDR_KERNEL=0x46f22
CONFIG_SRCADDR_DTB=0x1822
CONFIG_DEFAULT_DEVICE_TREE="pentagram-common"
CONFIG_DEBUG_UART=y
CONFIG_BOOTDELAY=0
CONFIG_CMD_BOOTZ=y
CONFIG_CMD_MD5SUM=y
CONFIG_MD5SUM_VERIFY=y
CONFIG_CMD_MEMINFO=y
CONFIG_CMD_GPT=y
CONFIG_CMD_MMC=y
CONFIG_CMD_PART=y
CONFIG_CMD_USB=y
# CONFIG_CMD_NET is not set
# CONFIG_CMD_NFS is not set
CONFIG_CMD_UUID=y
CONFIG_CMD_EXT2=y
CONFIG_CMD_FAT=y
CONFIG_OF_EMBED=y
CONFIG_ENV_IS_IN_MMC=y
CONFIG_DEVRES=y
CONFIG_DEBUG_DEVRES=y
CONFIG_DM_MMC=y
CONFIG_MMC_SP_8388=y
CONFIG_DEBUG_UART_BASE=0x0
CONFIG_DEBUG_UART_CLOCK=90000
CONFIG_DEBUG_UART_SHIFT=2
CONFIG_SUNPLUS_SERIAL=y
CONFIG_USB=y
CONFIG_USB_STORAGE=y
CONFIG_REGEX=y
```

## u-boot-sp/configs/pentagram_sp7021_emmc_b_defconfig
```kconfig
CONFIG_ARM=y
CONFIG_ARCH_PENTAGRAM=y
CONFIG_TARGET_PENTAGRAM_B_BOOT=y
CONFIG_SYS_ENV_SP7021_EVB=y
CONFIG_SRCADDR_KERNEL=0x1a22
CONFIG_SRCADDR_DTB=0x1822
CONFIG_DEFAULT_DEVICE_TREE="pentagram-common"
CONFIG_DEBUG_UART=y
CONFIG_SD_BOOT=y
CONFIG_BOOTDELAY=0
CONFIG_CMD_BOOTZ=y
CONFIG_CMD_MD5SUM=y
CONFIG_MD5SUM_VERIFY=y
CONFIG_CMD_MEMINFO=y
CONFIG_CMD_GPT=y
CONFIG_CMD_GPT_RENAME=y
CONFIG_CMD_MMC=y
CONFIG_CMD_PART=y
CONFIG_CMD_USB=y
CONFIG_CMD_UUID=y
CONFIG_CMD_EXT2=y
CONFIG_CMD_FAT=y
CONFIG_OF_EMBED=y
CONFIG_ENV_IS_IN_MMC=y
CONFIG_DEVRES=y
CONFIG_DEBUG_DEVRES=y
CONFIG_DM_MMC=y
CONFIG_MMC_SP_EMMC=y
CONFIG_MMC_SP_SD=y
CONFIG_DEBUG_UART_BASE=0x0
CONFIG_DEBUG_UART_CLOCK=90000
CONFIG_DEBUG_UART_SHIFT=2
CONFIG_SUNPLUS_SERIAL=y
CONFIG_USB=y
CONFIG_USB_STORAGE=y
CONFIG_REGEX=y
#
# Soc
#
CONFIG_OTP_SUNPLUS=y
#
# Pin controllers
#
CONFIG_PINCTRL=y
CONFIG_PINCTRL_FULL=y
CONFIG_PINCTRL_GENERIC=y
CONFIG_PINMUX=y
CONFIG_PINCTRL_SUNPLUS=y
#
# Net
#
CONFIG_DM_ETH=y
CONFIG_NETDEVICES=y
CONFIG_PHY_GIGE=y
CONFIG_SUNPLUS_L2SW=y
CONFIG_NET=y
CONFIG_LIB_RAND=y
CONFIG_NET_RANDOM_ETHADDR=y
#
# Network commands
#
CONFIG_CMD_NET=y
CONFIG_CMD_TFTPPUT=y
CONFIG_CMD_DHCP=y
CONFIG_CMD_PING=y
```
