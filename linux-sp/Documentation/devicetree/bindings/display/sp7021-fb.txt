## linux-sp/arch/riscv/configs/i143_chipP_ev_defconfig
```kconfig
CONFIG_SOC_I143=y
CONFIG_CMODEL_MEDLOW=y
CONFIG_HVC_RISCV_SBI=y
#CONFIG_SERIAL_8250=y
#CONFIG_SERIAL_8250_CONSOLE=y
#CONFIG_CMDLINE="earlycon=sp_uart,mmio32,0x9c000900 keep_bootcon"
CONFIG_SYSVIPC=y
CONFIG_IKCONFIG=y
CONFIG_IKCONFIG_PROC=y
# CONFIG_RD_GZIP is not set
# CONFIG_RD_BZIP2 is not set
# CONFIG_RD_LZMA is not set
# CONFIG_RD_XZ is not set
# CONFIG_RD_LZO is not set
# CONFIG_RD_LZ4 is not set
CONFIG_BLK_DEV_INITRD=y
CONFIG_INITRAMFS_COMPRESSION=""
CONFIG_EXPERT=y
CONFIG_BPF_SYSCALL=y
CONFIG_SMP=y
CONFIG_NET=y
CONFIG_UEVENT_HELPER=y
CONFIG_TMPFS=y
CONFIG_DEVTMPFS=y
CONFIG_DEVTMPFS_MOUNT=y
CONFIG_SERIAL_OF_PLATFORM=y
# CONFIG_VIRTIO_MENU is not set
CONFIG_NETDEVICES=y
# CONFIG_NET_VENDOR_ALACRITECH is not set
# CONFIG_NET_VENDOR_AMAZON is not set
# CONFIG_NET_VENDOR_AQUANTIA is not set
# CONFIG_NET_VENDOR_ARC is not set
# CONFIG_NET_VENDOR_AURORA is not set
# CONFIG_NET_VENDOR_BROADCOM is not set
# CONFIG_NET_VENDOR_CADENCE is not set
# CONFIG_NET_VENDOR_CAVIUM is not set
# CONFIG_NET_VENDOR_CIRRUS is not set
# CONFIG_NET_VENDOR_CORTINA is not set
# CONFIG_NET_VENDOR_EZCHIP is not set
# CONFIG_NET_VENDOR_FARADAY is not set
# CONFIG_NET_VENDOR_GOOGLE is not set
# CONFIG_NET_VENDOR_HISILICON is not set
# CONFIG_NET_VENDOR_HUAWEI is not set
# CONFIG_NET_VENDOR_INTEL is not set
# CONFIG_NET_VENDOR_MELLANOX is not set
# CONFIG_NET_VENDOR_MARVELL is not set
# CONFIG_NET_VENDOR_MICREL is not set
# CONFIG_NET_VENDOR_MICROCHIP is not set
# CONFIG_NET_VENDOR_MICROSEMI is not set
# CONFIG_NET_VENDOR_NATSEMI is not set
# CONFIG_NET_VENDOR_NETRONOME is not set
# CONFIG_NET_VENDOR_NI is not set
# CONFIG_NET_VENDOR_PENSANDO is not set
# CONFIG_NET_VENDOR_QUALCOMM is not set
# CONFIG_NET_VENDOR_RENESAS is not set
# CONFIG_NET_VENDOR_ROCKER is not set
# CONFIG_NET_VENDOR_SAMSUNG is not set
# CONFIG_NET_VENDOR_SEEQ is not set
# CONFIG_NET_VENDOR_SOLARFLARE is not set
# CONFIG_NET_VENDOR_SMSC is not set
# CONFIG_NET_VENDOR_SOCIONEXT is not set
# CONFIG_NET_VENDOR_STMICRO is not set
# CONFIG_NET_VENDOR_SYNOPSYS is not set
# CONFIG_NET_VENDOR_VIA is not set
# CONFIG_NET_VENDOR_WIZNET is not set
# CONFIG_NET_VENDOR_XILINX is not set
# CONFIG_USB_SUPPORT is not set
# CONFIG_BLOCK is not set
# CONFIG_HW_RANDOM is not set
# CONFIG_HWMON is not set
# CONFIG_MOUSE_PS2_ALPS is not set
# CONFIG_MOUSE_PS2_BYD is not set
# CONFIG_MOUSE_PS2_CYPRESS is not set
# CONFIG_MOUSE_PS2_FOCALTECH is not set
# CONFIG_VGA_CONSOLE is not set
#CONFIG_SERIAL_EARLYCON_RISCV_SBI=y
# CONFIG_FILE_LOCKING is not set
# CONFIG_DNOTIFY is not set
# CONFIG_INOTIFY_USER is not set
CONFIG_PRINTK_TIME=y
CONFIG_PINCTRL=y
CONFIG_PINCTRL_SPPCTL_I143=y
CONFIG_DEBUG_FS=y
CONFIG_NVMEM=y
CONFIG_EXT2_FS=y
CONFIG_EXT2_FS_XATTR=y
CONFIG_EXT3_FS=y
CONFIG_EXT3_FS_POSIX_ACL=y
CONFIG_EXT3_FS_SECURITY=y
CONFIG_EXT4_ENCRYPTION=y
CONFIG_EXT4_DEBUG=y
```

## linux-sp/arch/riscv/configs/i143_chipP_ev_initramfs_defconfig
```kconfig
CONFIG_SOC_I143=y
CONFIG_CMODEL_MEDLOW=y
CONFIG_HVC_RISCV_SBI=y
#CONFIG_SERIAL_8250=y
#CONFIG_SERIAL_8250_CONSOLE=y
#CONFIG_CMDLINE="earlycon=sp_uart,mmio32,0x9c000900 keep_bootcon"
CONFIG_SWAP=y
CONFIG_DEFAULT_HOSTNAME="i143-EMU"
CONFIG_SYSVIPC=y
CONFIG_IKCONFIG=y
CONFIG_IKCONFIG_PROC=y
CONFIG_BLK_DEV_INITRD=y
# CONFIG_RD_GZIP is not set
# CONFIG_RD_BZIP2 is not set
# CONFIG_RD_LZMA is not set
# CONFIG_RD_XZ is not set
# CONFIG_RD_LZO is not set
# CONFIG_RD_LZ4 is not set
CONFIG_INITRAMFS_SOURCE="../rootfs/initramfs/disk/ ../rootfs/initramfs/initramfs.devnodes"
CONFIG_INITRAMFS_COMPRESSION=""
CONFIG_EXPERT=y
CONFIG_BPF_SYSCALL=y
CONFIG_SMP=y
CONFIG_BLOCK=y
CONFIG_BLK_SCSI_REQUEST=y
CONFIG_BLK_DEV_BSG=y
CONFIG_BLK_DEBUG_FS=y
CONFIG_MSDOS_PARTITION=y
CONFIG_EFI_PARTITION=y
CONFIG_MQ_IOSCHED_DEADLINE=y
CONFIG_MQ_IOSCHED_KYBER=y
CONFIG_NET=y
CONFIG_PACKET=y
CONFIG_PACKET_DIAG=y
CONFIG_UNIX=y
CONFIG_INET=y
CONFIG_IP_MULTICAST=y
CONFIG_IP_PNP=y
CONFIG_IP_PNP_DHCP=y
CONFIG_IP_PNP_BOOTP=y
CONFIG_IP_PNP_RARP=y
CONFIG_BRIDGE=y
CONFIG_VLAN_8021Q=y
CONFIG_UEVENT_HELPER=y
CONFIG_DEVTMPFS=y
CONFIG_DEVTMPFS_MOUNT=y
CONFIG_SERIAL_OF_PLATFORM=y
# CONFIG_VIRTIO_MENU is not set
CONFIG_BLK_DEV=y
CONFIG_SCSI=y
CONFIG_SCSI_DMA=y
CONFIG_SCSI_PROC_FS=y
CONFIG_BLK_DEV_SD=y
CONFIG_CHR_DEV_SG=y
CONFIG_SCSI_LOWLEVEL=y
CONFIG_HPD_DETECTION=y
CONFIG_NETDEVICES=y
# CONFIG_NET_VENDOR_ALACRITECH is not set
# CONFIG_NET_VENDOR_AMAZON is not set
# CONFIG_NET_VENDOR_AQUANTIA is not set
# CONFIG_NET_VENDOR_ARC is not set
# CONFIG_NET_VENDOR_AURORA is not set
# CONFIG_NET_VENDOR_BROADCOM is not set
# CONFIG_NET_VENDOR_CADENCE is not set
# CONFIG_NET_VENDOR_CAVIUM is not set
# CONFIG_NET_VENDOR_CIRRUS is not set
# CONFIG_NET_VENDOR_CORTINA is not set
# CONFIG_NET_VENDOR_EZCHIP is not set
# CONFIG_NET_VENDOR_FARADAY is not set
# CONFIG_NET_VENDOR_GOOGLE is not set
# CONFIG_NET_VENDOR_HISILICON is not set
# CONFIG_NET_VENDOR_HUAWEI is not set
# CONFIG_NET_VENDOR_INTEL is not set
# CONFIG_NET_VENDOR_MELLANOX is not set
# CONFIG_NET_VENDOR_MARVELL is not set
# CONFIG_NET_VENDOR_MICREL is not set
# CONFIG_NET_VENDOR_MICROCHIP is not set
# CONFIG_NET_VENDOR_MICROSEMI is not set
# CONFIG_NET_VENDOR_NATSEMI is not set
# CONFIG_NET_VENDOR_NETRONOME is not set
# CONFIG_NET_VENDOR_NI is not set
# CONFIG_NET_VENDOR_PENSANDO is not set
# CONFIG_NET_VENDOR_QUALCOMM is not set
# CONFIG_NET_VENDOR_RENESAS is not set
# CONFIG_NET_VENDOR_ROCKER is not set
# CONFIG_NET_VENDOR_SAMSUNG is not set
# CONFIG_NET_VENDOR_SEEQ is not set
# CONFIG_NET_VENDOR_SOLARFLARE is not set
# CONFIG_NET_VENDOR_SMSC is not set
# CONFIG_NET_VENDOR_SOCIONEXT is not set
# CONFIG_NET_VENDOR_STMICRO is not set
# CONFIG_NET_VENDOR_SYNOPSYS is not set
# CONFIG_NET_VENDOR_VIA is not set
# CONFIG_NET_VENDOR_WIZNET is not set
CONFIG_NET_VENDOR_SUNPLUS_GL2SW=y
CONFIG_USB_NET_DRIVERS=y
# CONFIG_MOUSE_PS2_ALPS is not set
# CONFIG_MOUSE_PS2_BYD is not set
# CONFIG_MOUSE_PS2_CYPRESS is not set
# CONFIG_MOUSE_PS2_FOCALTECH is not set
# CONFIG_LEGACY_PTYS is not set
# CONFIG_HW_RANDOM is not set
CONFIG_PINCTRL=y
CONFIG_PINCTRL_SPPCTL_I143=y
# CONFIG_HWMON is not set
# CONFIG_VGA_CONSOLE is not set
# CONFIG_NET_VENDOR_XILINX is not set
CONFIG_USB_VIDEO_CLASS=y
CONFIG_MEDIA_USB_SUPPORT=y
CONFIG_USB_HID=y
CONFIG_GEMINI_USB=y
CONFIG_USB_SUPPORT=y
CONFIG_USB_COMMON=y
CONFIG_USB_PORT0=y
CONFIG_USB_PORT1=y
CONFIG_USB_GADGET_ENABLED=y
CONFIG_USB_GADGET_PORT0_ENABLED=y
CONFIG_USB_ARCH_HAS_HCD=y
CONFIG_USB=y
CONFIG_USB_DEFAULT_PERSIST=y
CONFIG_USB_AUTOSUSPEND_DELAY=2
CONFIG_USB_USE_PLATFORM_RESOURCE=y
CONFIG_USB_EHCI_HCD=y
CONFIG_USB_EHCI_TT_NEWSCHED=y
CONFIG_USB_EHCI_HCD_PLATFORM=y
CONFIG_USB_OHCI_HCD=y
CONFIG_USB_OHCI_HCD_PLATFORM=y
CONFIG_USB_STORAGE=y
CONFIG_SUNPLUS_USB_PHY=y
CONFIG_USB_SUNPLUS_OTG=y
CONFIG_USB_XHCI_HCD=y
CONFIG_USB_DWC3=y
CONFIG_NVMEM=y
CONFIG_EXT2_FS=y
CONFIG_EXT2_FS_XATTR=y
CONFIG_EXT3_FS=y
CONFIG_EXT3_FS_POSIX_ACL=y
CONFIG_EXT3_FS_SECURITY=y
CONFIG_EXT4_ENCRYPTION=y
CONFIG_EXT4_DEBUG=y
CONFIG_FILE_LOCKING=y
CONFIG_MANDATORY_FILE_LOCKING=y
CONFIG_FSNOTIFY=y
# CONFIG_DNOTIFY is not set
CONFIG_INOTIFY_USER=y
CONFIG_FANOTIFY=y
CONFIG_FAT_FS=y
CONFIG_VFAT_FS=y
CONFIG_FAT_DEFAULT_CODEPAGE=437
CONFIG_FAT_DEFAULT_IOCHARSET="utf8"
CONFIG_TMPFS=y
CONFIG_NLS_CODEPAGE_437=y
CONFIG_NLS_ASCII=y
CONFIG_NLS_ISO8859_1=y
CONFIG_NLS_UTF8=y
#CONFIG_SERIAL_EARLYCON_RISCV_SBI=y
CONFIG_GENERIC_ALLOCATOR=y
CONFIG_SG_POOL=y
CONFIG_SBITMAP=y
CONFIG_PRINTK_TIME=y
CONFIG_DEBUG_FS=y
CONFIG_FRAMEBUFFER_CONSOLE=y
CONFIG_FRAMEBUFFER_CONSOLE_DEFERRED_TAKEOVER=y
```

## linux-sp/arch/riscv/configs/i143_chipP_zebu_defconfig
```kconfig
CONFIG_SOC_I143=y
CONFIG_CMODEL_MEDLOW=y
CONFIG_HVC_RISCV_SBI=y
#CONFIG_SERIAL_8250=y
#CONFIG_SERIAL_8250_CONSOLE=y
#CONFIG_CMDLINE="earlycon=sp_uart,mmio32,0x9c000900 keep_bootcon"
CONFIG_SYSVIPC=y
CONFIG_IKCONFIG=y
CONFIG_IKCONFIG_PROC=y
# CONFIG_RD_GZIP is not set
# CONFIG_RD_BZIP2 is not set
# CONFIG_RD_LZMA is not set
# CONFIG_RD_XZ is not set
# CONFIG_RD_LZO is not set
# CONFIG_RD_LZ4 is not set
CONFIG_BLK_DEV_INITRD=y
CONFIG_INITRAMFS_SOURCE="../rootfs/initramfs/disk/ ../rootfs/initramfs/initramfs.devnodes"
CONFIG_INITRAMFS_COMPRESSION=""
CONFIG_EXPERT=y
CONFIG_BPF_SYSCALL=y
CONFIG_SMP=y
CONFIG_UEVENT_HELPER=y
CONFIG_TMPFS=y
CONFIG_DEVTMPFS=y
CONFIG_DEVTMPFS_MOUNT=y
CONFIG_SERIAL_OF_PLATFORM=y
# CONFIG_VIRTIO_MENU is not set
# CONFIG_USB_SUPPORT is not set
# CONFIG_BLOCK is not set
# CONFIG_HW_RANDOM is not set
# CONFIG_HWMON is not set
# CONFIG_MOUSE_PS2_ALPS is not set
# CONFIG_MOUSE_PS2_BYD is not set
# CONFIG_MOUSE_PS2_CYPRESS is not set
# CONFIG_MOUSE_PS2_FOCALTECH is not set
# CONFIG_VGA_CONSOLE is not set
#CONFIG_SERIAL_EARLYCON_RISCV_SBI=y
# CONFIG_FILE_LOCKING is not set
# CONFIG_DNOTIFY is not set
# CONFIG_INOTIFY_USER is not set
CONFIG_PRINTK_TIME=y
CONFIG_PINCTRL=y
CONFIG_PINCTRL_SPPCTL_I143=y
CONFIG_DEBUG_FS=y
CONFIG_NVMEM=y
```

## linux-sp/drivers/dma/sp-cbdma/Kconfig
```kconfig
#
# CBDMA subsystem configuration
#

menu "Sunplus CBDMA"

config SUNPLUS_CBDMA
	tristate "CBDMA driver support"
	depends on ARCH_PENTAGRAM
	help
	  This is a option to support Sunplus CBDMA device.

config SUNPLUS_CBDMA_PROXY
	tristate "CBDMA proxy driver support"
	depends on ARCH_PENTAGRAM
	help
	  This is a option to support Sunplus CBDMA proxy device.

endmenu
```

## linux-sp/drivers/dma/sunplus/Kconfig
```kconfig
#
# CBDMA subsystem configuration
#

menu "Sunplus CB-DMA"

config SUNPLUS_CBDMA
	tristate "Sunplus SP7021 CB-DMA driver support"
	depends on SOC_SP7021
	help
	  This driver supports the CB-DMA device on the Sunplus SP7021 SoC.

config SUNPLUS_CBDMA_PROXY
	tristate "Sunplus SP7021 CB-DMA proxy driver support"
	depends on SOC_SP7021
	help
	  This driver supports the CB-DMA proxy device on the Sunplus SP7021 SoC.

endmenu
```

## linux-sp/drivers/gpu/gpu_2d/Kconfig
```kconfig
# SPDX-License-Identifier: GPL-2.0-only
config GPU_2D
        bool "Vivante GPU_2D(GC520) Driver"
        depends on SOC_I143
        default y
        help
          Say yes if kernel should use gpu_2d.

          If unsure, choose Y.
```

## linux-sp/drivers/media/platform/sp-display/display/Kconfig
```kconfig
config VIDEO_SP_DISP
	tristate "SUNPLUS DISPLAY Driver"
	depends on VIDEO_DEV && VIDEO_V4L2
	select VIDEOBUF2_DMA_CONTIG
	select VIDEOBUF2_VMALLOC	
	default y
	---help---
		Support for the SUNPLUS SP7021B display driver.
```

## linux-sp/drivers/media/platform/sp-display/hdmitx/Kconfig
```kconfig
config VIDEO_SP_HDMITX
	tristate "SUNPLUS HDMITX Driver"
	select PINCTRL
	select PINCTRL_SPPCTL
	default y
	---help---
	  Support for the SUNPLUS SP7021 display.
		
config HPD_DETECTION
	bool "Hot Plug Detection"
	depends on VIDEO_SP_HDMITX
	default n

config EDID_READ
	bool "Support EDID Read"
	depends on HPD_DETECTION
	default y

if !EDID_READ && VIDEO_SP_HDMITX

config MODE_SELECT
	bool "Mode Select"
	default y
	
choice
	prompt "Select Mode"

config HDMI_MODE
	bool "HDMI Mode"
	---help---
	   Support HDMI mode.

config DVI_MODE
	bool "DVI Mode"
	---help---
	   Support DVI mode

endchoice

endif
```

## linux-sp/drivers/media/platform/sunplus/display/i143/Kconfig
```kconfig
config VIDEO_I143_DISP
	tristate "SUNPLUS I143 DISPLAY Driver"
	depends on VIDEO_DEV && VIDEO_V4L2 && SOC_I143
	select VIDEOBUF2_DMA_CONTIG
	select VIDEOBUF2_VMALLOC	
	default n
	---help---
		Support for the SUNPLUS I143 display driver.
```

## linux-sp/drivers/media/platform/sunplus/display/sp7021/Kconfig
```kconfig
config VIDEO_SP7021_DISP
	tristate "SUNPLUS SP7021 DISPLAY Driver"
	depends on VIDEO_DEV && VIDEO_V4L2 && SOC_SP7021
	select VIDEOBUF2_DMA_CONTIG
	select VIDEOBUF2_VMALLOC	
	default y
	---help---
		Support for the SUNPLUS SP7021B display driver.
```

## linux-sp/drivers/media/platform/sunplus/hdmitx/Kconfig
```kconfig
config VIDEO_SP_HDMITX
	tristate "Sunplus HDMITX Driver"
	default y if SOC_SP7021 || SOC_I143
	---help---
	  Support for the SUNPLUS SP7021 and i143 display.

config HPD_DETECTION
	bool "Hot Plug Detection"
	depends on VIDEO_SP_HDMITX
	default n

config EDID_READ
	bool "Support EDID Read"
	depends on HPD_DETECTION
	default y

if !EDID_READ && VIDEO_SP_HDMITX

config MODE_SELECT
	bool "Mode Select"
	default y

choice
	prompt "Select Mode"

config HDMI_MODE
	bool "HDMI Mode"
	---help---
	   Support HDMI mode.

config DVI_MODE
	bool "DVI Mode"
	---help---
	   Support DVI mode

endchoice

endif
```

## linux-sp/drivers/media/platform/sunplus/mipicsi/Kconfig
```kconfig
config MIPICSI_RX_SUNPLUS_SP7021
	tristate "Sunplus SP7021 MIPI/CSI-RX driver"
	depends on SOC_SP7021 && VIDEO_DEV && VIDEO_V4L2
	select VIDEOBUF2_DMA_CONTIG
	select VIDEOBUF2_VMALLOC
	default n
	help
	  This driver supports the MIPI/CSI-RX device on the Sunplus SP7021 SoC.

config MIPICSI_RX_SUNPLUS_I143
	tristate "Sunplus I143 MIPI/CSI-RX driver"
	depends on SOC_I143 && VIDEO_DEV && VIDEO_V4L2
	select VIDEOBUF2_DMA_CONTIG
	select VIDEOBUF2_VMALLOC
	select I2C_MIPI_SUNPLUS
	default n
	help
	  This driver supports the MIPI/CSI-RX device on the Sunplus I143 SoC.
```

## linux-sp/drivers/media/sp-mipi/Kconfig
```kconfig
config VIDEO_SP_MIPICSI_RX
	tristate "Sunplus MIPI/CSI-RX Driver"
	depends on VIDEO_DEV && VIDEO_V4L2
	select VIDEOBUF2_DMA_CONTIG
	select VIDEOBUF2_VMALLOC
	default n
	---help---
	  Sunplus MIPI/CSI-RX driver supports for Sunplus SP-7021 based boards.
```

## linux-sp/drivers/media/video/Kconfig
```kconfig
menuconfig SUNPLUS_VIDEO_SENSOR_SUPPORT
	bool "Sunplus Video Sensor Support"
	help
	  Enable video sensor support.
	  If you have such devices, say Y.

if SUNPLUS_VIDEO_SENSOR_SUPPORT

config VIDEO_SENSOR_GC0310
	tristate "Video Sensor (GC0310) Driver"
	default n
	---help---
	  Supports video sensor GC0310.

choice
	prompt "Selected Mode"
	depends on VIDEO_SENSOR_GC0310
	---help---
	  Press Enter to select mode if this is not you want.

config GC0310_RAW8
	bool "Bayer RAW8"
	---help---
	  In this mode, GC0310 outputs Bayer RAW8 video stream.

config GC0310_YUY2
	bool "YUY2/YUYV"
	---help---
	  In this mode, GC0310 outputs YUY2/YUYV (YUV422/8bit) video stream.

endchoice

config VIDEO_SENSOR_IMX219
	tristate "Video Sensor (IMX219) Driver"
	default n
	---help---
	  Supports video sensor IMX219.

choice
	prompt "Selected Inage Size"
	depends on VIDEO_SENSOR_IMX219
	---help---
	  Press Enter to select image size if this is not you want.

config IMX219_3280x2464
	bool "3280x2464"
	---help---
	  In this mode, IMX219 output image size 3280x2464.

config IMX219_1920x1080
	bool "1920x1080"
	---help---
	  In this mode, IMX219 output image size 1920x1080.
endchoice

config VIDEO_SENSOR_OV5647
	tristate "Video Sensor (OV5647) Driver"
	default n
	---help---
	  Supports video sensor OV5647.

choice
	prompt "Selected Inage Size"
	depends on VIDEO_SENSOR_OV5647
	---help---
	  Press Enter to select image size if this is not you want.

config OV5647_640x480
	bool "640x480"
	---help---
	  In this mode, OV5647 output image size 640x480.

config OV5647_1280x720
	bool "1280x720"
	---help---
	  In this mode, OV5647 output image size 1280x720.

config OV5647_1280x960
	bool "1280x960"
	---help---
	  In this mode, OV5647 output image size 1280x960.

config OV5647_2592x1944
	bool "2592x1944"
	---help---
	  In this mode, OV5647 output image size 2592x1944.

endchoice

config VIDEO_SENSOR_OV9281
	tristate "Video Sensor (OV9281) Driver"
	default n
	---help---
	  Supports video sensor OV9281.

config VIDEO_SENSOR_OV9281_ISP
	tristate "Video Sensor (OV9281_ISP) Driver"
	default n
	---help---
	  Supports SunplusIT 3D Eye-tracker (video sensor OV9281 + ISP) board.
	  This driver does not support auto sensor detection.
	  It will be loaded in unconditionally when it is enabled.
	  Please disable other video sensor drivers.



endif
```

## linux-sp/drivers/misc/iop/Kconfig
```kconfig
#
# IOP subsystem configuration
#

menu "IOP support"

config SUNPLUS_IOP
	tristate "Sunplus IOP support"
	default y
	help
	Sunplus I/O processor (8051) driver which supports Q channel detection
source "drivers/misc/iop/qtest/Kconfig"
endmenu
```
