## linux-sp/Documentation/devicetree/bindings/display/sp7021-fb.txt
```
Sunplus SP7021 series SoC Graphics Backend framebuffer driver

Required properties:
- compatible: should be "sunplus,sp7021-fb"

Example:

fb_device {
	compatible = "sunplus,sp7021-fb";
};
```

## linux-sp/Documentation/devicetree/bindings/gpio/sunplus,sp7021-gpio.txt
~~~~
---------------------------------------------
  SoC SunPlus/Tibbo SP7021 gpio driver
---------------------------------------------

NOTE
------------
This driver is the part of sp7021pctl driver at
 drivers/pinctrl/sppctl/sp7021_gpio*
but may be separated and used along. Take a look at
 Documentation/devicetree/bindings/pinctrl/sunplus,sp7021-pctl.txt
for information about the PinCtrl managment part.
------------

This document outlines the gpio subsystem available on SP7021 SoC.

Available functions:

- old and new /sys gpio interface API
- 72 gpio lines (8 groups of 8 pins), 8 interrupt lines on GPIO1 group
- human-readable representation of the current gpio configuration in
  /sys/kernel/debug/gpio

------
Files
------

The driver directories and files are:

- (dir)  /sys/devices/platform/soc@B/9c000300.gpio
- (dir)  /sys/class/gpio
- (file) /sys/kernel/debug/gpio
- (dir)  /sys/firmware/devicetree/base/soc@B/gpio@0x9C000300

---------
DTS file
---------

A driver is platform dependent, requested by DTS node.

Example:

    soc@B {
	gpio: gpio@0x9C000300 {
    	    compatible = "sp7021,sp_gpio";
    	    gpio-controller;
    	    #gpio-cells = <2>;
    	    reg = <0x9C000300 0x80>, <0x9C000380 0x80>, <0x9C0032e4 0x80>;
    	    interrupt-parent = <&intc>;
    	    interrupts =
    	    <120 IRQ_TYPE_LEVEL_HIGH>,
    	    <121 IRQ_TYPE_LEVEL_HIGH>,
    	    <122 IRQ_TYPE_LEVEL_HIGH>,
    	    <123 IRQ_TYPE_LEVEL_HIGH>,
    	    <124 IRQ_TYPE_LEVEL_HIGH>,
    	    <125 IRQ_TYPE_LEVEL_HIGH>,
    	    <126 IRQ_TYPE_LEVEL_HIGH>,
    	    <127 IRQ_TYPE_LEVEL_HIGH>;
    	    resets = <&rstc RST_GPIO>;
	};
    }

All properties are optional and has compile-time default values.

The compatible key may have one of the following values:

- sunplus,sp7021-gpio

The reg key should contain 3 entries - the physical addresses of GPIO control 
register groups.

---------
DTS gpio usage example
---------

/ {
    soc@B {
	leds {
	    pinctrl-names = "default";
	    pinctrl-0 = <&user_leds_s0>;
	    compatible = "gpio-leds";
	    led@2 {
		label = "SG";
		gpios = <&gpio 8 GPIO_ACTIVE_HIGH>;
		linux,default-trigger = "heartbeat";
		default-state = "off";
	    };
	};
    };
};

DTS enables LED heartbeat trigger on GMX_8 pin by 
``` ===
gpios = <&gpio 8 ..> 
``` ===
~~~~

## linux-sp/Documentation/devicetree/bindings/pinctrl/sunplus,sp7021-pctl.txt
```
---------------------------------------------
 SoC SunPlus/Tibbo SP7021 pinmux driver
---------------------------------------------

NOTE
------------
This document describes the pinctrl (managment) part of sp7021pctl driver
that includes GPIO functions described in 
 Documentation/devicetree/bindings/gpio/sunplus,sp7021-gpio.txt
------------

This document outlines the additional pin control subsystem available on 
SunPlus SP7021 SoC.

Available functions:

- list all peripheral functions that may be assigned
- individual and bulk pin-function assignment
- human-readable representation of the current pinmux mapping
- firmware dump and load
- traditional PinMux API
- DTS bindings

SP7021 platform has 64 pins and 120 different functions.

------
Files
------

The driver directories are:

/sys/devices/platform/soc@B/9c000100.pctl/
- direct "hacker" pinmux functions bindings interface
/sys/kernel/debug/pinctrl/
- traditional pinctrl sysfs API
/sys/firmware/devicetree/base/soc@B/pctl@0x9C000100/
- main pinctrl DTS node;

------
Direct "hacker" pinmux functions bindings interface
------

/sys/devices/platform/soc\@B/9c000100.pctl/

Files are created after driver initialization:

- dbgi (txt, read/write) - the debug level
  (0 - no debug, 1 - main messages, 2 - verbose)

- list_funcs (txt, read only) - full list of available functions in a 
  certain order
  (L2SW_CLK_OUT, L2SW_MAC_SMI_MDC,..., PWM0,..., SPIM0_INT, SPIM0_CLK, SPIM0_DO, 
  SPIM0_DI, etc.)

- txt_map (txt, read only) - human-readable pin assignment
  (for ex.: 040 L2SW_CLK_OUT - pin#40 assigned to L2SW_CLK_OUT function)

- fwname (txt, read/write) - firmware filename relative to /lib/firmware

- fw (bin, read/write) - firmware file

- 120 function-named files (bin, read/write), for ex:
L2SW_CLK_OUT
L2SW_LED_FLASH0
...
UA4_TX
  
  Each file is the function. Write binary pin number into the function file
  to set mux. Allowed to use the same pin number in several functions.

---------
Traditional pinctrl sysfs infomational API
---------

/sys/kernel/debug/pinctrl/

- pinctrl-handles: active pinctrl dts status information
- pctl/pins: pins list
- pctl/pinmux-functions: list of pins available for each function
- pctl/pinconf-pins: pins additional properties (OD,etc)
- pctl/pinmux-pins: current pin-functions assigment

---------
Device Tree bindings
---------

/sys/firmware/devicetree/base/soc\@B/pctl\@0x9C000100/
+
find /sys/firmware/ -name "*pin*"

A driver is platform dependent, requested by DTS node.

Full PinCtl node example:

	pctl: pctl@0x9C000100 {
		compatible = "sunplus,sp7021-pctl";
		reg = <0x9C000100 0x100>, <0x9C000300 0x80>, <0x9C000380 0x80>, <0x9C0032e4 0x80>;
		gpio-controller;
		#gpio-cells = <2>;
		interrupt-parent = <&intc>;
		interrupts =
			<120 IRQ_TYPE_LEVEL_HIGH>,
			<121 IRQ_TYPE_LEVEL_HIGH>,
			<122 IRQ_TYPE_LEVEL_HIGH>,
			<123 IRQ_TYPE_LEVEL_HIGH>,
			<124 IRQ_TYPE_LEVEL_HIGH>,
			<125 IRQ_TYPE_LEVEL_HIGH>,
			<126 IRQ_TYPE_LEVEL_HIGH>,
			<127 IRQ_TYPE_LEVEL_HIGH>;
		clocks = <&clkc GPIO>;
		resets = <&rstc RST_GPIO>;
                fwname = "sppctl.bin";
	};


Mandatory options are:
 compatible, reg.
All other properties are optional.

The compatible key may have one of the following values:

- sunplus,sp7021-pctl

The reg key should contain 4 entries - the physical regs for SP7021 

The fwname define a path to the firmware relative to /lib/firmware.

--------------
Firmware file
--------------

At driver start-up loads default pins layout from firmware file defined in 
DTS file.

The lack of firmware does not affect the functionality.

The firmware may be applied in two ways:

- to write a file name into /sys/devices/platform/soc@B/9c000100.pctl/fwname
- to write binary pinmux data into /sys/devices/platform/soc@B/9c000100.pctl/fw

The firmware file must be at least 120 bytes (1 byte per function). All 
bytes after 120'th will be ignored. The data must be written in binary form.
Each byte is the pin number.

Functions are listed in file "list_funcs" in the certain order.
For example byte#0 - L2SW_CLK_OUT, byte#1 - L2SW_MAC_SMI_MDC etc. 
Byte#0 = 0x10 means, that pin #16 (0x10 in hex) assigned to function 
L2SW_CLK_OUT (position #0 in list_funcs).
0x00 in position #0 means no pin is assigned to L2SW_MAC_SMI_MDC function.

-------------------
Pins configuration
-------------------

File txt_map is the human-readable format of the current pinmux mapping.
Cut from this file:

040 L2SW_CLK_OUT
034 L2SW_MAC_SMI_MDC
035 L2SW_LED_FLASH0

Legend:
Pin #40 assigned to L2SW_CLK_OUT function,
pin #34 assigned to L2SW_MAC_SMI_MDC,
pin #35 assigned to L2SW_LED_FLASH0, etc.

Alternatively, you can read the binary 1-byte value from function files, i.e.
L2SW_CLK_OUT, L2SW_MAC_SMI_MDC, L2SW_LED_FLASH0 etc. from the driver directory.

To assign certain function to a pin one-byte value must be written to the function file.
For ex., to assign pin #1 (G_MX8) to L2SW_LED_ON0 function:

// in octal:
# echo -e "\01" > /sys/devices/platform/soc\@B/9c000100.pctl/L2SW_LED_ON0.
// in hex:
# echo -e "\x0A" > /sys/devices/platform/soc\@B/9c000100.pctl/L2SW_LED_ON0.
// the other form:
printf "%b" '\x66\x6f\x6f' > ....
```

## linux-sp/Documentation/devicetree/bindings/pwm/sp7021-pwm.txt
```
Sunplus SP7021 series SoC PWM controller

Required properties:
- compatible: should be "sunplus,sp7021-pwm"
- reg: physical base address and length of the controller's registers
- #pwm-cells: should be 2. See pwm.txt in this directory for a description of
  the cells format.
- clocks: phandle to the PWM source clock

Example:

pwm: pwm@0x9c007480 {
	#pwm-cells = <3>;
	compatible = "sunplus,sp7021-pwm";
	reg = <0x9c007480 0x80>;
	clocks = <&sysslow>;
};
```
