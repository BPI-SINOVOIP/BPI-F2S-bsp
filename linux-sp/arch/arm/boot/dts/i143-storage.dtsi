/dts-v1/;

#define ENABLE_EMMC  /*Default enable emmc, if no define ENABLE_EMMC, it mean ENABLE_SPINAND. */

/ {

	soc@B {
		compatible = "simple-bus";
		#address-cells = <1>;
		#size-cells = <1>;
		ranges;

		interrupt-parent = <&intc>;

		/* B modules */
		/*emmc and spinand can't enable at the same time, they used the same pins. */
#ifdef ENABLE_EMMC
		mmc0: mmc@emmc {
			pinctrl-names = "default";
			pinctrl-0 = <&emmc_mux>;
		};
#else
		spinand0: spinand@sp_spinand {
			compatible = "sunplus,sp_spinand";
			reg = <0x9c002B80 0x50>;
			interrupt-parent = <&intc>;
			interrupts = <149 IRQ_TYPE_LEVEL_HIGH>;
			linux,part-probe = "ofpart", "sunplus_part";
			clocks = <&clkc SPIND>;
			resets = <&rstc RST_SPIND>;
		};		
#endif
	
	};
};
