/dts-v1/;

#include "skeleton.dtsi"

#include <dt-bindings/clock/sp-q628.h>
#include <dt-bindings/interrupt-controller/sp-intc.h> /* SP_INTC_EXT_INT1 */
#include <dt-bindings/reset/sp-q628.h>

/ {

	soc@B {
		compatible = "simple-bus";
		#address-cells = <1>;
		#size-cells = <1>;
		ranges;

		interrupt-parent = <&intc>;

		/* B modules */
		/*emmc and spinand can't enable at the same time, they used the same pins. */
		mmc0: mmc@emmc {
			pinctrl-names = "default";
			pinctrl-0 = <&emmc_mux>;
		};

		spinand0: spinand@sp_spinand {
			compatible = "sunplus,sp_spinand";
			reg = <0x9c002B80 0x50>;
			interrupt-parent = <&intc>;
			interrupts = <149 IRQ_TYPE_LEVEL_HIGH>;
			linux,part-probe = "ofpart", "sunplus_part";
			clocks = <&clkc SPIND>;
			resets = <&rstc RST_SPIND>;
			status = "disabled";
		};		
	};
};
